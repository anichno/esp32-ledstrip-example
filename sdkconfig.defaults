## sdkconfig.defaults
```kconfig
# Rust often needs a bit of an extra main task stack size compared to C (the default is 3K)
CONFIG_ESP_MAIN_TASK_STACK_SIZE=16384

CONFIG_ESPTOOLPY_FLASHSIZE_4MB=y
```
